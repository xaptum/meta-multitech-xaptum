## conf/layer.conf
```bitbake
# We have a conf and classes directory, add to BBPATH
BBPATH .= ":${LAYERDIR}"

# We have a recipes-* directories, add to BBFILES
BBFILES += "${LAYERDIR}/recipes-*/*/*.bb \
	${LAYERDIR}/recipes-*/*/*.bbappend"

BBFILE_COLLECTIONS += "multitech-xaptum"
BBFILE_PATTERN_multitech-xaptum = "^${LAYERDIR}/"
BBFILE_PRIORITY_multitech-xaptum = "6"
```
